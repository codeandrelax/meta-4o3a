/dts-v1/;
/plugin/;

/ {
    fragment@0 {
        target = <&spidev0>;

        __overlay__ {
            status = "disabled";
        };
    };
    fragment@1 {
        target = <&spi0>; // Change the target to match your SPI controller
        __overlay__ {
            #address-cells = <1>;
            #size-cells = <0>;
            status = "okay";

            led_strip: tlc59731@0 {
                status = "okay";
                reg = <0>;
                compatible = "ti,tlc59731";
                spi-max-frequency = <100000>; // Set the desired maximum frequency
                spi-mode = <0>; // Set the desired SPI mode
                nleds = <26>;
            };
        };
    };
};
