## conf/layer.conf
```bitbake
# We have a conf and classes directory, add to BBPATH
BBPATH .= ":${LAYERDIR}"

# We have recipes-* directories, add to BBFILES
BBFILES += "${LAYERDIR}/recipes-*/*/*.bb \
            ${LAYERDIR}/recipes-*/*/*.bbappend"

BBFILE_COLLECTIONS += "meta-4o3a"
BBFILE_PATTERN_meta-4o3a = "^${LAYERDIR}/"
BBFILE_PRIORITY_meta-4o3a = "6"

LAYERDEPENDS_meta-4o3a = "core"
LAYERSERIES_COMPAT_meta-4o3a = "kirkstone"
```
